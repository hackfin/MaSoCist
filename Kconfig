## Kconfig
```kconfig
mainmenu "SoC configuration"

config VENDOR_CONFIG
	string
	option env="VENDOR"

comment "Generic config"

config SOCDESC
	string "Soc device description"
	default "system"
	help
	  System device description. The possible system device descriptions
	  are found in hdl/plat/*.xml

config MAP_PREFIX
	bool "Enable map prefix"
	depends on HAVE_GENSOC
	default n
	help
	  Enables map prefix if your system device description needs extended
	  namespaces. Do not change unless you create an entirely new device
	  description from scratch.

source "vendor/$VENDOR_CONFIG/Kconfig"

source hdl/core/Kconfig

choice
	prompt "Bus system"
	default WISHBONE

config WISHBONE
	bool "Wishbone bus support"
	help
	  Support for Wishbone bus

config LOCALBUS
	bool "Simple local bus support"
	help
	  Support for simple local bus

config AHB
	bool "AHB support"
	depends on PYPS
	help
	  Preliminary AHB (light) variant
	  (Legacy / compatibility to other cores)

endchoice

choice
	prompt "Target FPGA architecture"
	default MACHXO2

config MACHXO2
	bool "Lattice MachXO2"
	help
	  Support for Lattice MACHXO2 platforms

config MACHXO3
	bool "Lattice MachXO3"
	help
	  Support for Lattice MACHXO3 platforms

config ECP3
	bool "Lattice ECP3"
	help
	  Support for Lattice ECP3 platforms

config ECP5
	bool "Lattice ECP5"
	help
	  Support for Lattice ECP5 platforms

config SPARTAN3
	bool "Xilinx Spartan3"
	help
	  Support for Xilinx Spartan3 platforms

config SPARTAN6
	bool "Xilinx Spartan6"
	help
	  Support for Xilinx Spartan6 platforms

config VIRTUAL_SILICON
	bool "Virtual silicon"
	help
	  Virtual Silicon option (Simulation only)

endchoice

menu "Clock configuration"

config MACHXO2_OSC_CLK
	depends on MACHXO2 || MACHXO3
	int "Oscillator clock in Hz"
	default "22170000"

config SYSCLK
	depends on !MACHXO2 && !MACHXO3
	int "System clock in Hz"
	default "25000000"

config VIDEO_MASTERCLK
	depends on VIDEO
	int "Video reference clock in Hz"
	default "27000000"

config VIRTUALCLK_PERIOD
	depends on virtual
	string "Virtual board clock period [ns, us, ms]"
	default "20 ns"

config PLL_MUL
	depends on MACHXO2 || MACHXO3 || ECP3 || SPARTAN6
	int "PLL multiplier"
	default "7"

config PLL_DIV
	depends on MACHXO2 || MACHXO3 || ECP3 || SPARTAN6
	int "PLL divider"
	default "2"

endmenu

menu "Peripheral I/O"
source hdl/perio/Kconfig
endmenu

source hdl/tap/Kconfig

source sw/Kconfig

menu "Simulation options"

choice
	prompt "Simulation target architecture"
	default NATIVE

config NATIVE
	bool "Native"
	help
	  Typically the native platform is your Linux box, i.e. somewhat
	  intel'ish.

config MINGW32
	bool "mingw32"
	help
	  If you need to run your executables on a Windows machine, use this
	  option. You need to have a working toolchain for this.

endchoice


config EMULATE_PLATFORM_IP
	bool "Emulate platform IP"
	help
	  This option emulates platform specific IP such as hardware specific
	  PLL units, etc. in a generic way. When instancing vendor specific
	  primitives, you may have to write emulation code when using this option.

config USE_PLATFORM_IP_LIBRARY
	bool "Simulate platform IP"
	help
	  This option uses the vendor-provided IP code for simulation and
	  adds support for std_logic_arith quirks.
	  If you use generated IP cores that are encrypted, rather use
	  the EMULATE_PLATFORM_IP option.

config LIBSIM
	string "Simulation library name"
	depends on HAVE_VTAP
	default "jtagsim"
	help
	  Name of the simulation library (ghdlex extension)

config SIM_BUS_ERROR
	bool "Abort simulation on bus error"
	depends on HAVE_GENSOC
	default n
	help
	  The simulation will abort on a peripheral bus error (unknown address)
	  when this variable is set  

config SIM_BREAK
	bool "Abort simulation on SW break"
	depends on HAVE_GENSOC
	default n
	help
	  The simulation will abort on a software break when emulation is
	  not enabled.


endmenu
```

## hdl/core/Kconfig
```kconfig
menu "Common Address configuration"
	visible if ZEALOT || ZPUNG || ZPUNGV2 || NEO430 || NETPP_CPU || RISCV_ARCH

config ADDR_WIDTH
	int "I/O address width (range)"
	default "17"

config BRAM_ADDR_WIDTH
	int "Block RAM address width (range)"
	default "14"

config DRAM_ADDR_WIDTH
	int "Separate DRAM address width (range)"
	depends on RISCV_ARCH
	default "14"

config MMR_ADDR_BIT
	int "Memory mapped register address bit"
	range BRAM_ADDR_WIDTH ADDR_WIDTH
	default "16"
	help
	  This bit defines the address base of the I/O mapped (MMR) memory
	  space. IMPORTANT: When you change this bit, you will have to regenerate
	  all the software, plus set the $MMR_OFFSET variable in the gdb scripts,
	  accordingly. Also note that this defines a new SoC architecture, i.e.
	  you must define a new SoC description plus use another TAP id.
	  Note that autodetection by firmware will only work when using a
	  'downward compatible' access method with MSBs set.

endmenu

# No more support for Little Endian
# config LITTLE_ENDIAN
# 	bool "Little endian memory mapping"
# 	depends on ZPUNG
# 	default n

# Include all vendor specific CPUs in their Kconfig now
# include pyps/Kconfig
```

## hdl/neo430/Kconfig
```kconfig
comment "NEO430 specific configuration"

config NEO430_NATIVE
	bool "Use neo430 native configuration"
	default "y"
	help
	  When selected, uses native NEO430 configuration with built-in
	  'native' hardware support. If you wish to use the MaSoCist SoC
	  generation system, set to 'n'.
	  NOTE: you need to make sure, when issuing hardware in this
	  configuration, that the licenses are compatible.

menu "NEO430 hardware configuration"

config NEO430_DMEM_WIDTH
	depends on !NEO430_NATIVE
	int "DMEM address width"
	default "9"
	range 10 12
	help
	  Data mem width, size = 2**DMEM_WIDTH

config NEO430_DADD
	bool "DADD"
	default "n"

config NEO430_MULDIV
	depends on NEO430_NATIVE
	bool "MULDIV"
	default "n"

config NEO430_WDT
	depends on NEO430_NATIVE
	bool "Watchdog"
	default "n"

config NEO430_PWM
	depends on NEO430_NATIVE
	bool "Watchdog"
	default "n"

config NEO430_GPIO
	depends on NEO430_NATIVE
	bool "GPIO"
	default "n"

config NEO430_TIMER
	depends on NEO430_NATIVE
	bool "TIMER"
	default "n"

config NEO430_USART
	depends on NEO430_NATIVE
	bool "USART"
	default "n"

config NEO430_CRC
	depends on NEO430_NATIVE
	bool "CRC"
	default "n"

config NEO430_TRNG
	depends on NEO430_NATIVE
	bool "TRNG"
	default "n"

config NEO430_BOOTLD
	bool "BOOTLD"
	default "n"

config NEO430_IMEM_RO
	bool "IMEM_RO"
	default "n"

endmenu
```

## hdl/perio/Kconfig
```kconfig
config GENSOC_READ_DELAY
	bool "Perio bus read delay"
	default "n"
	help
	  Introduces wait cycle for bus reads in the perio module generator.
	  This adds a delay but allows for higher bus speeds and prevents
	  logic congestion. Make sure your CPU supports busy wait cycles on the
	  I/O memory access.

config GENSOC_RESET_DEFAULTS
	bool "Perio register reset"
	default "0"
	help
	  Implements a reset for generated register sets.
	  If this configuration is enabled, a system reset will reset the
	  registers supplied with default specifications to the specified
	  value. When disabled, the default value will only be initialized
	  at a FPGA cold boot.

config PLAYGROUND
	bool "Core playground (TESTING)"
	depends on VIRTUAL_SILICON
	help
	  For testing/prototyping, if you want to play around

config HDMI
	bool "HDMI support"
	depends on ECP3
	help
	  Support for HDMI

config CRC16
	bool "CRC16 extension"
	help
	  Simple register based hardware CRC16 calculator

config GPIO
	bool "GPIO controller support"
	help
	  GPIO controller support

config NUM_GPIO
	depends on GPIO
	int "Number of GPIO banks"
	default "2"

config DMA
	bool "Generic DMA support"
	help
	  DMA support

choice
	prompt "DMA controller type"
	depends on DMA
	default DMA_SIMPLE

config DMA_SIMPLE
	bool "Simple DMA controller support"
	depends on DMA
	help
	  Simple DMA controller support

config DMA_ADVANCED
	bool "Advanced DMA controller support"
	depends on DMA && SECTION5_PROPRIETARY_MODULES
	help
	  Advanced DMA controller support
	  Not supported on ZPU

endchoice 

config UNISI
	bool "UniSI serial controller"
	default n
	depends on DMA && SECTION5_PROPRIETARY_MODULES && CCAP_MICROCODE_ASE
	help
	  Universal serial interface engine for various interfaces such as
	  SPI, I2C, SPORT (I2S), UART

config UNISI_CAN
	bool "UniSI CAN extension"
	depends on UNISI
	help
	  CAN extension for UniSI controller

config SPI
	bool "SPI support"
	default y
	help
	  Generic SPI controller support

config SPI_BITS_POWER
	depends on SPI
	range 3 5
	int "Bit width power [3, 4, 5] -> 8, 16, 32 bits"
	default "3"
	help
	  Note: The bit width used must match the bitfield size of the
	  SPI_CONTROL::NBITS field in the SPI core register map.
	  Changing this option requires changes in the XML description as well.

config TIMER
	bool "Generic Timer support"
	default y
	help
	  Generic Timer and PWM controller support

config NUM_TMR
	depends on TIMER
	int "Number of TIMER/PWMs"
	default "3"

choice
	prompt "PWM type"
	depends on TIMER
	default PWM_SIMPLE

config PWM_NONE
	bool "No PWM, standalone timer"
	help
	  No PWM  

config PWM_SIMPLE
	bool "Simple PWM controller support"
	help
	  Simple PWM controller support
	  OpenSource variant of a simple PWM controller.

config PWM_ADVANCED
	bool "Advanced PWM controller support"
	depends on SECTION5_PROPRIETARY_MODULES
	help
	  Adcanved PWM (three phase) controller support
	  Non-OS advanced PWM controller for BLDC.

endchoice

config SIC
	bool "Simple system interrupt controller"
	help
	  System interrupt controller support

config NUM_IRQSRC
	depends on SIC
	int "Number of IRQ sources"
	default "4"
	help
	  Number of IRQ sources the SoC can have.

config LCDIO
	bool "LCD parallel driver"
	help
	  A asynchronous parallel interface to LCD I/O (like ili9125, ...)

config MAC
	bool "Ethernet TriMAC core"
	help
	  A 10/100/1000 MBit Ethernet MAC with DMA functionality

choice
	prompt "Phy Interface"
	default MAC_GMII

config MAC_MII
	depends on MAC
	bool "MII interface"
	help
	  Use MII interface (10M/100M)

config MAC_RGMII
	depends on MAC
	bool "RGMII interface"
	help
	  Use RGMII interface

config MAC_GMII
	depends on MAC
	bool "GMII interface"
	help
	  Use GMII interface

config MAC_RMII
	depends on MAC
	bool "RMII interface"
	help
	  Use RMII interface (100MBit only)
endchoice

config MAC_RXFIFO_BITS
	depends on MAC
	int "Number of RX FIFO memory address bits"
	default "8"
	help
	  Defines the memory size (2**MAC_RXFIFO_BITS)

config MAC_TXFIFO_BITS
	depends on MAC
	int "Number of TX FIFO memory address bits"
	default "11"
	help
	  Defines the memory size (2**MAC_TXFIFO_BITS) of the TX buffer

config MACHXO_EFB
	bool "MACHXO[2,3] hardened function block"
	depends on MACHXO2 || MACHXO3
	help
	  Support for MACHXO hardened IP function core (SPI, I2C, PLL, Flash)
	  Hardware only, this HDL is not available for simulation.

config MACHXO_EFB_SPI
	bool "Enable EFB SPI"
	depends on MACHXO_EFB
	default "n"
	help
	  Enable SPI in EFB (Note: generated IP core must match this setting)

menu "UART support"

config UART
	bool "Generic UART support"
	help
	  Generic support for UART interfaces

config UART_SIMPLE
	bool "Simple UART"
	depends on UART
	help
	  Support for Simple UART implementation

config NUM_UART
	depends on UART_SIMPLE
	int "Number of UARTs"
	default "1"

config OC_UART16550
	bool "OpenCores UART 16550"
	depends on WISHBONE && UART
	help
	  Support for Wishbone 16550 UART

config DEFAULT_UART_BAUDRATE
	int "Default UART baud rate"
	depends on UART
	default "115200"

config UART_DEBUGCONSOLE
	bool "UART debug console"
	depends on UART
	default "y"
	help
	  Debug console on UART0

endmenu

menu "Generic FIFO support"

config FIFO
	bool "FIFO support"
	default "n"
	help
	  When 'y', enable FIFO support

choice
	prompt "FIFO Interface"
	default FIFO_GENERIC

config FIFO_GENERIC
	depends on FIFO
	bool "Generic FIFO interface"
	help
	  Use generic FIFO interface

config FIFO_VIRTUAL
	bool "Virtual GHDLEX FIFO"
	depends on FIFO  && VIRTUAL_SILICON
	help
	  Use GHDLEX virtual FIFO

endchoice

config FIFO_WORDWIDTH
	int "Fifo word width"
	default "1"
	depends on FIFO
	help
	  FIFO word width in bytes

config FIFO_NUM
	int "Numbers of FIFO instances"
	default "2"
	depends on FIFO
	help
	  FIFO instances

endmenu

menu "I2C support"

config TWI
	bool "Simple TWI"
	default y
	help
	  Simple, standalone Two Wire Interface

config I2C
	bool "I2C support"

config OC_I2C_RD1046
	bool "OpenCores I2C controller Lattice Refdesign 1046"
	depends on WISHBONE && I2C
	help
	  Support for OpenCores I2C controller (Lattice RD1046 variant)

config I2CBRIDGE
	bool "I2Cbridge support"
	help
	  Support for I2C bridge (i2c slave emulation)

endmenu

menu "Virtual devices support"

config VIRTUAL_CONSOLE
	bool "Virtual Console"
	default "false"
	depends on VIRTUAL_SILICON
	help
	  Support for Virtual Console through /var/run/iopipe

config VIRTUAL_RAM
	bool "Use VirtualRAM"
	help
	  This option uses GHDLEX virtual RAM (if supported)

config VIRTUAL_I2CSLAVE
	bool "Virtual I2C slave"
	help
	  Enables the virtual i2c slave defined by i2cslave.xml

config VIRTUAL_I2CSLAVE_ADDR
	depends on VIRTUAL_I2CSLAVE
	int "Virtual I2C slave address"
	range 1 126
	help
	  Virtual I2C slave address (7 bit)

config VIRTUAL_SENSOR
	depends on SECTION5_PROPRIETARY_MODULES
	bool "Virtual Sensor"
	help
	  This option enables a virtual sensor interface for imaging co-simulation

config VIRTUAL_UART
	depends on UART
	bool "Use Virtual UART"
	help
	  This option uses a virtual UART using unix pipes


endmenu
```

## hdl/tap/Kconfig
```kconfig
menu "TAP configuration"

# config TAP_ID
# 	string "TAP IDCODE"
# 	default "deadbeef"
# 	help
# 	  The TAP IDCODE for the in circuit emulation. This is used to detect
# 	  the TAP type and features used by the CPU core. Values of 'deadbeef'
# 	  and similar nerdiness are used for experimental cores. Others follow
# 	  the section5 code scheme for stable cores.

config TAPCLK_PERIOD
	string "TAP clock period time"
	default "50 ns"
	help
	  The TAP clock period [ms,us,ns,ps]. Make sure the TAP clock frequency is
	  at least half of the core clock frequency. Otherwise, your simulation
	  might run slower or show spurious debug events.

choice
	prompt "Simulation TAP type"
	default VTAP

config VTAP_DEBUG
	bool "GHDLex Debug TAP"
	depends on HAVE_VTAP
	help
	  This is an enhanced raw TAP with a few more debug pins accessible
	  It is not compatible to the hardware TAP and may be subject to
	  changes.
	
config VTAP
	bool "GHDLex VirtualTAP"
	depends on HAVE_VTAP
	help
	  Virtual TAP for verification
	
config DUMMYTAP
	bool "Dummy TAP"

config GHDLEX_DEFAULT
	bool "GHDL simple test access port"
	help
	  This is a simplified access port to manipulate signals.
	  If you enable this, a libghdlex-netpp.so is required, see
	  $(GHDLEX) package
	
endchoice

config VTAP_JTAG
	bool "Virtual JTAG interface"
	depends on VTAP
	help
	  Enable virtual JTAG (ICEbear Pro compatible)
	

endmenu
```
