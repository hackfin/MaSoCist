## sw/Kconfig
```kconfig
menu "Software options"

config PRINTF
	bool "Support for printf()"
	default y
	help
	  When set, enable simple printf functionality. Note that this must not
	  be enabled for safety applications.

config STRICT_PRECISION
	bool "printf strict string precision"
	depends on PRINTF
	help
	  When set, requires a string precision spec in the format string, like
	  '%-16s'. If not specified, the sprintf will print out '<PRECISION!>'
	  instead. If not defined, a default limiting string length will be set.

choice
	prompt "libc functions"
	default LIBC_NONE

config LIBC_NONE
	bool "No libc"
	help
	  Do not support libc calls at all

config LIBC_MINIMUM
	bool "Minimal emulation"
	help
	  Very few libc calls are emulated (arch/$ARCH/sysemu)

config LIBC_NEWLIB
	bool "Newlib libc enabled"
	depends on !NEO430
	help
	  Newlib libc is used for linking

endchoice


choice
	prompt "Code optimization"
	default OPT_SIZE

config OPT_SIZE
	bool "Size"
	help
	  Optimize for code size

config OPT_SPEED
	bool "Speed"
	help
	  Optimize for code speed

endchoice

menu "Networking"

config ETHERNET
	bool "Ethernet support"
	depends on MAC
	default y
	help
	  Ethernet 802.11 HW EMAC support

config MAC_MTU
	int "Ethernet MTU"
	depends on ETHERNET
	default 512
	help
	  Maximum raw ethernet packet size (MTU)
	  Depends on amount of memory or buffer layout used
	  (implementation dependent)

endmenu

config FULL_REENTRANCY
	bool "IRQ reentrancy"
	default n
	help
	  When enabled, no static memory registers are used, however you
	  have to supply the _regpush()/_regpop() functions to your code.
	  In this case, the generated code is fully reentrant without code
	  modifications.

config TASK_MANAGEMENT
	bool "Enable rudimentary task management"
	default n
	help
	  Rudimentary time slice based task management.

endmenu
```

## vendor/opensource/Kconfig
```kconfig
comment "Opensource distribution config"

config OPENSOURCE
	bool "Opensource distribution"
	default y
	# Do no longer force to use these modules:
	# select GPIO
	# Do not force to use SPI:
	# select SPI
	# select TIMER
	# select UART
	# select UART_SIMPLE
	help
	  When defined, this is an open source distribution

choice
	prompt "CPU core"
	default ZEALOT

config ZEALOT
	bool "Zealot"
	help
	  Zealot ZPU architecture with debugger enhancement

config RISCV_ARCH
	bool "RISCV architecture"
	help
	  Support for RISCV architectures

config NEO430
	bool "Neo430"
	depends on OPENSOURCE
	help
	  NEO430 architecture designed by Stephan Nolting
	  Support for this configuration is still experimental


config ZPUNG
	bool "ZPUng (ZPU next gen)"
	depends on !OPENSOURCE
	select ZPUNG_VHDL_ONLY
	select GENSOC_READ_DELAY
	help
	  section5 proprietary pipelined ZPU architecture with hardware debugger

endchoice

choice
	prompt "RISC V processor implementation"
	depends on RISCV_ARCH
	default RISCV_PYRV32

config RISCV_POTATO
	bool "RISCV potato"
	depends on RISCV_ARCH
	help
	  RISCV potato architecture (https://github.com/skordal/potato.git)
	  Support for this configuration is still experimental

config RISCV_PYRV32
	depends on !OPENSOURCE
	bool "RISCV pyrv32"
	depends on RISCV_ARCH
	select GENSOC_READ_DELAY
	select ADDR_WITH
	help
	  section5 proprietary riscv32 in a non-configureable edition

endchoice


config ZPUNG_VHDL_ONLY
	bool "VHDL only release"
	depends on ZPUNG

choice
	prompt "Platform"
	default virtual

config virtual
	bool "Virtual ZPUng board"
	depends on ZEALOT || ZPUNG || RISCV_POTATO
	help
	  Virtual board, no hardware implementation

config virtual_neo430
	bool "Virtual NEO430 board"
	select VIRTUAL_SILICON
	help
	  Virtual board, no hardware implementation

config virtual_rv32ui
	bool "Virtual RISCV board"
	select VIRTUAL_SILICON
	help
	  Virtual board, no hardware implementation

config papilio
	bool "Papilio board"
	select SPARTAN3
	help
	  Xilinx Spartan3E-250 based Papilio board

config versa_ecp5
	bool "Versa ECP5 eval board"
	select ECP5
	select UART
	help
	  ECP5 based eval board. Note that there is also an ECP5G version of it
	  See SYNTHESIS options.

config evdk_ecp5
	bool "ECP5 Embedded Vision development kit"
	select ECP5
	select UART
	help
	  ECP5 based video processing eval board. Note: Might require Gigabit Ethernet
	  piggy back board for streaming support
     

config xo2starter
	bool "MACHXO2-7000 starter breakout board"
	select MACHXO2
	help
	  MachXO2-7000 starter kit breakout board


endchoice

config PLAT_EXTENSION
	string "Platform extension"
	default "main"
	help
	  Platform HDL variant extension

config HAVE_VTAP
	bool "Virtual TAP support"
	default "y"
	help
	  Set to 'y' when Virtual TAP support is present.

if NEO430 = 'y'
source "hdl/neo430/Kconfig"
endif
```
